## boards/arm/b_l072z_lrwan1/Kconfig.board
```kconfig
# Kconfig - STMicroelectronics B-L072Z-LRWAN1 Discovery board configuration
#
# Copyright (c) 2018 Aleksandr Makarov <aleksandr.makarov@mailbox.org>
#
# SPDX-License-Identifier: Apache-2.0
#

config BOARD_B_L072Z_LRWAN1
	bool "STMicroelectronics B-L072Z-LRWAN1 Discovery kit"
	depends on SOC_STM32L072XZ
```

## boards/arm/b_l072z_lrwan1/Kconfig.defconfig
```kconfig
# Kconfig - Dragino LSN50 LoRA Sensor Node board configuration
#
# Copyright (c) 2018 Endre Karlson <endre.karlson@gmail.com>
#
# SPDX-License-Identifier: Apache-2.0
#

if BOARD_B_L072Z_LRWAN1

config BOARD
	default "b_l072z_lrwan1"

if UART_CONSOLE

config UART_STM32_PORT_2
	default y

endif # UART_CONSOLE

endif # BOARD_B_L072Z_LRWAN1
```

## boards/arm/stm32l072z_lrwan1/Kconfig.board
```kconfig
# Kconfig - Dragino LSN50 LoRA Sensor Node board configuration
#
# Copyright (c) 2018 Endre Karlson <endre.karlson@gmail.com>
#
# SPDX-License-Identifier: Apache-2.0
#

config BOARD_B_L072Z_LRWAN1
	bool "B-L072Z-LRWAN1 LoRa®/Sigfox™ Discovery kit"
	depends on SOC_STM32L072XZ
```
